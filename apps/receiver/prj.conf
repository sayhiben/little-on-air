## CMakeLists.txt
```
# SPDX-License-Identifier: MIT
cmake_minimum_required(VERSION 3.20.0)

set(LOA_ROOT ${CMAKE_CURRENT_SOURCE_DIR}/../..)
set(DTC_OVERLAY_FILE ${LOA_ROOT}/boards/xiao_ble_nrf52840.overlay)

find_package(Zephyr REQUIRED HINTS $ENV{ZEPHYR_BASE})
project(little_on_air_receiver)

set(LOA_LED_RED_CALIBRATION_PERMILLE 1000 CACHE STRING
    "Red-channel calibration in permille")
set(LOA_LED_GREEN_CALIBRATION_PERMILLE 650 CACHE STRING
    "Green-channel calibration in permille")
set(LOA_LED_BLUE_CALIBRATION_PERMILLE 500 CACHE STRING
    "Blue-channel calibration in permille")

target_sources(app PRIVATE
  src/brightness_settings.c
  src/ble_server.c
  src/main.c
  src/pair_reset.c
  src/device_indicator.c
  src/mood_indicator.c
  src/status_output.c
  src/padded_pixels.c
  ${LOA_ROOT}/src/protocol.c
  ${LOA_ROOT}/src/brightness.c
  ${LOA_ROOT}/src/receiver_processor.c
  ${LOA_ROOT}/src/record.c
  ${LOA_ROOT}/src/reset_gesture.c
  ${LOA_ROOT}/src/reset_input.c
  ${LOA_ROOT}/src/status.c
  ${LOA_ROOT}/src/store.c
  ${LOA_ROOT}/src/ws2812_frame.c
)
target_include_directories(app PRIVATE src ${LOA_ROOT}/include)
target_compile_definitions(app PRIVATE
  LOA_LED_RED_CALIBRATION_PERMILLE=${LOA_LED_RED_CALIBRATION_PERMILLE}
  LOA_LED_GREEN_CALIBRATION_PERMILLE=${LOA_LED_GREEN_CALIBRATION_PERMILLE}
  LOA_LED_BLUE_CALIBRATION_PERMILLE=${LOA_LED_BLUE_CALIBRATION_PERMILLE}
)
```

## Kconfig
```
# SPDX-License-Identifier: MIT
mainmenu "Little On Air receiver"

source "Kconfig.zephyr"

config LOA_RECEIVER_POWER_LED
	bool "Use onboard RGB LED for device status independently of the sign"
	default y

config LOA_PIXELS_PADDED_SPI
	bool "Bench-test SPI pixels with leading and trailing LOW padding"
	depends on LED_STRIP && SPI && SOC_NRF52840 && !WS2812_STRIP_SPI
	help
	  Replace the default WS2812 SPI driver for the four front GRB pixels.
	  Send 300 us of continuous LOW before and after the pixel payload.
	  Use pixels.conf, pixels-padded.conf and the existing pixel overlay.

config LOA_PIXELS_TIMING_375NS
	bool "Compare 375 ns zero pulses using 8 MHz padded SPI"
	depends on LOA_PIXELS_PADDED_SPI
	help
	  Use ten SPI clocks per pixel bit, preserving the 1.25 us bit period.
	  Zero is 375 ns HIGH / 875 ns LOW; one is 750 ns HIGH / 500 ns LOW.
	  Requires the pixels-timing375 overlay in addition to the pixel overlay.
	  This is an unvalidated timing alternative for the unidentified pixels.
```

## sample.yaml
```
sample:
  name: Little On Air receiver
tests:
  little_on_air.receiver.build:
    build_only: true
    platform_allow:
      - xiao_ble/nrf52840
    tags:
      - bluetooth
      - little_on_air
```

## prj.conf
```kconfig
# Core and power
CONFIG_MAIN_STACK_SIZE=3072
CONFIG_SYSTEM_WORKQUEUE_STACK_SIZE=2048
CONFIG_PWM=y
CONFIG_SERIAL=n
CONFIG_CONSOLE=n
CONFIG_UART_CONSOLE=n
CONFIG_USB_DEVICE_STACK_NEXT=n
CONFIG_LOG=n
CONFIG_ASSERT=n
CONFIG_COMPILER_WARNINGS_AS_ERRORS=y
CONFIG_REBOOT=y

# Flash-backed application and Bluetooth settings
CONFIG_FLASH=y
CONFIG_FLASH_MAP=y
CONFIG_FLASH_PAGE_LAYOUT=y
CONFIG_NVS=y
CONFIG_SETTINGS=y
CONFIG_SETTINGS_NVS=y

# Bluetooth peripheral with encrypted, bonded GATT
CONFIG_BT=y
CONFIG_BT_PERIPHERAL=y
CONFIG_BT_SMP=y
CONFIG_BT_SMP_SC_PAIR_ONLY=y
CONFIG_BT_BONDABLE=y
CONFIG_BT_SETTINGS=y
CONFIG_BT_PRIVACY=y
CONFIG_BT_FILTER_ACCEPT_LIST=y
CONFIG_BT_MAX_CONN=1
CONFIG_BT_MAX_PAIRED=1
CONFIG_BT_DEVICE_NAME="Little On Air Display"
CONFIG_BT_ATT_TX_COUNT=3

# The assembled sign always uses the application-owned padded pixel driver.
CONFIG_LED_STRIP=y
CONFIG_SPI=y
CONFIG_WS2812_STRIP_SPI=n
```

## debug.conf
```kconfig
# USB CDC diagnostics. Merge with prj.conf using EXTRA_CONF_FILE=debug.conf.
CONFIG_SERIAL=y
CONFIG_CONSOLE=y
CONFIG_UART_CONSOLE=y
CONFIG_STDOUT_CONSOLE=y
CONFIG_UART_LINE_CTRL=y
CONFIG_USB_DEVICE_STACK_NEXT=y
CONFIG_CDC_ACM_SERIAL_INITIALIZE_AT_BOOT=y
CONFIG_CDC_ACM_SERIAL_PID=0x0006
CONFIG_CDC_ACM_SERIAL_PRODUCT_STRING="Little On Air Receiver Debug"

CONFIG_LOG=y
CONFIG_LOG_MODE_DEFERRED=y
CONFIG_LOG_BUFFER_SIZE=8192
CONFIG_LOG_DEFAULT_LEVEL=3
CONFIG_LOG_BACKEND_UART=y
CONFIG_LOG_PRINTK=y
CONFIG_ASSERT=y
CONFIG_REBOOT=y
```

## pixels-padded.conf
```kconfig
# Add AFTER pixels.conf for the first-pixel timing experiment.
# The default profile remains available as the comparison/rollback image.
CONFIG_WS2812_STRIP_SPI=n
CONFIG_LOA_PIXELS_PADDED_SPI=y
```

## pixels-timing375.conf
```kconfig
# Add AFTER pixels.conf and pixels-padded.conf for the timing-only comparison.
CONFIG_LOA_PIXELS_TIMING_375NS=y
```

## pixels.conf
```kconfig
# Four external GRB pixels; requires xiao_ble_nrf52840_pixels.overlay.
CONFIG_LED_STRIP=y
CONFIG_SPI=y
```

## dts/bindings/led_strip/loa,padded-ws2812-spi.yaml
```yaml
# SPDX-License-Identifier: MIT
description: |
  Little On Air's experimental padded SPI driver for four GRB pixels.
  This application driver accepts ten-bit symbols, unlike the upstream
  worldsemi,ws2812-spi driver. It clocks continuous LOW around each frame.

compatible: "loa,padded-ws2812-spi"

include: [spi-device.yaml, ws2812.yaml]

properties:
  bits-per-symbol:
    type: int
    required: true
    const: 10
  spi-zero-frame:
    type: int
    required: true
  spi-one-frame:
    type: int
    required: true
```

## src/main.c
```c
/* SPDX-License-Identifier: MIT */
#include <zephyr/bluetooth/bluetooth.h>
#include <zephyr/bluetooth/conn.h>
#include <zephyr/kernel.h>
#include <zephyr/logging/log.h>
#include <zephyr/settings/settings.h>

#include <little_on_air/reset_input.h>
#include <little_on_air/store.h>

#include "ble_server.h"
#include "brightness_settings.h"
#include "device_indicator.h"
#include "mood_indicator.h"
#include "pair_reset.h"

#if defined(CONFIG_UART_CONSOLE)
#include <errno.h>
#include <string.h>
#include <hal/nrf_power.h>
#include <zephyr/drivers/uart.h>
#include <zephyr/sys/reboot.h>

static void bench_usb_poll(void)
{
	static char line[32];
	static size_t used;
	static bool overflow;
	const struct device *uart = DEVICE_DT_GET(DT_CHOSEN(zephyr_console));
	uint8_t c;
	while (uart_poll_in(uart, &c) == 0) {
		if (c == '\r') {
			continue;
		}
		if (c != '\n') {
			if (used < sizeof(line) - 1) {
				line[used++] = c;
			} else {
				overflow = true;
			}
			continue;
		}
		line[used] = 0;
		used = 0;
		if (overflow) {
			overflow = false;
			printk("BENCH ERROR command too long\n");
			continue;
		}
		if (strcmp(line, "pair-reset") == 0) {
			int err = loa_pair_reset_request();
			printk("BENCH pair-reset saved=%d\n", err);
		} else if (strcmp(line, "reboot") == 0 || strcmp(line, "bootloader") == 0) {
			printk("BENCH %s\n", line);
			k_sleep(K_MSEC(250));
			if (strcmp(line, "bootloader") == 0) {
				nrf_power_gpregret_set(NRF_POWER, 0U, 0x57U);
			}
			sys_reboot(SYS_REBOOT_COLD);
		} else if (strcmp(line, "status") == 0) {
			struct loa_message current = loa_store_get_state();
			struct loa_brightness brightness = loa_brightness_settings_get();
			printk("BENCH bonded=%u saved=%u tx=%08x status=%u\n",
			       loa_ble_server_has_bond(), loa_store_has_state(),
			       current.transaction_id, current.status);
			printk("BENCH brightness_tx=%08x frame=%u indicator=%u\n",
			       brightness.transaction_id, brightness.frame, brightness.indicator);
		} else {
			printk("BENCH commands: status | pair-reset | reboot | bootloader\n");
		}
	}
}
#endif

LOG_MODULE_REGISTER(loa_receiver_main);

int main(void)
{
	struct loa_boot_input input;
	struct loa_message initial_state = {
		.transaction_id = 0U,
		.status = LOA_STATUS_OFF,
	};
	int err;

	err = loa_mood_indicator_init();
	if (err != 0) {
		return err;
	}
	loa_device_indicator_init();
	input = loa_reset_input_capture();
	LOG_INF("boot button_press=%u factory_reset=%u", input.button_press, input.factory_reset);

	err = bt_enable(NULL);
	if (err != 0) {
		LOG_ERR("Bluetooth enable failed err=%d", err);
		return err;
	}
	LOG_INF("Bluetooth enabled");
	err = settings_load();
	if (err != 0) {
		LOG_ERR("settings load failed err=%d", err);
		return err;
	}
	LOG_INF("settings loaded");
	err = loa_brightness_settings_init();
	if (err != 0) {
		LOG_ERR("brightness restore failed err=%d", err);
		return err;
	}
	err = loa_reset_input_resolve(&input);
	if (err != 0) {
		LOG_ERR("reset gesture storage failed err=%d", err);
		return err;
	}
	input.factory_reset = input.factory_reset || loa_pair_reset_pending();

	if (input.factory_reset) {
		err = loa_pair_reset_mark();
		if (err != 0) {
			return err;
		}
		err = bt_unpair(BT_ID_DEFAULT, BT_ADDR_LE_ANY);
		LOG_INF("factory reset unpair result=%d", err);
		if (err != 0) {
			return err;
		}
		err = loa_store_clear_state();
		LOG_INF("factory reset state clear result=%d", err);
		if (err != 0) {
			return err;
		}
		err = loa_pair_reset_complete();
		if (err != 0) {
			return err;
		}
	} else if (loa_store_has_state()) {
		initial_state = loa_store_get_state();
	}
	LOG_INF("initial transaction=0x%08x status=%u", initial_state.transaction_id,
		initial_state.status);

	err = loa_ble_server_init(&initial_state);
	if (err != 0) {
		LOG_ERR("BLE server init failed err=%d", err);
		return err;
	}
	err = loa_ble_server_start(input.button_press || input.factory_reset);
	if (err != 0) {
		LOG_ERR("BLE server start failed err=%d", err);
		return err;
	}
	LOG_INF("receiver ready");

#if defined(CONFIG_UART_CONSOLE)
	/* CDC ACM needs its OUT endpoint armed even with polling reads. */
	uart_irq_rx_enable(DEVICE_DT_GET(DT_CHOSEN(zephyr_console)));
#endif
	while (true) {
#if defined(CONFIG_UART_CONSOLE)
		bench_usb_poll();
		k_sleep(K_MSEC(10));
#else
		k_sleep(K_FOREVER);
#endif
	}
	return 0;
}
```

## src/ble_server.c
```c
/* SPDX-License-Identifier: MIT */
#include <errno.h>
#include <string.h>

#include <zephyr/bluetooth/bluetooth.h>
#include <zephyr/bluetooth/conn.h>
#include <zephyr/bluetooth/gatt.h>
#include <zephyr/bluetooth/hci.h>
#include <zephyr/bluetooth/uuid.h>
#include <zephyr/kernel.h>
#include <zephyr/logging/log.h>
#include <zephyr/sys/atomic.h>

#include <little_on_air/protocol.h>
#include <little_on_air/receiver_processor.h>
#include <little_on_air/store.h>
#include <little_on_air/pairing_control.h>

#include "ble_server.h"
#include "brightness_settings.h"
#include "device_indicator.h"
#include "mood_indicator.h"
#include "pair_reset.h"
#include "status_output.h"

#if !defined(CONFIG_BT_SMP_SC_PAIR_ONLY) || defined(CONFIG_BT_SMP_SC_ONLY)
#error "Little On Air requires LE Secure Connections pairing with Just Works support"
#endif

LOG_MODULE_REGISTER(loa_receiver_ble);

#define PAIRING_WINDOW    K_SECONDS(60)
#define ADV_RESTART_DELAY K_MSEC(100)
#define ADV_RETRY_DELAY   K_MSEC(250)
#define ADV_FAST_INTERVAL 0x00a0U
#define ADV_SLOW_INTERVAL 0x0640U

static struct bt_uuid_128 service_uuid = BT_UUID_INIT_128(LOA_BT_UUID_SERVICE_VAL);
static struct bt_uuid_128 command_uuid = BT_UUID_INIT_128(LOA_BT_UUID_COMMAND_VAL);
static struct bt_uuid_128 state_uuid = BT_UUID_INIT_128(LOA_BT_UUID_STATE_VAL);

static struct loa_receiver_processor processor;
static struct bt_conn *current_conn;
static struct k_work indication_work;
static struct k_work_delayable advertising_restart_work;
static struct k_work_delayable pairing_timeout_work;
static struct bt_gatt_indicate_params indication_params;
static uint8_t state_payload[LOA_PROTOCOL_PAYLOAD_LEN];
static atomic_t indicating;
static bool indications_enabled;
static bool advertising;
static bool pairing_window_open;
static bool bonded;

static int persist_state(const struct loa_message *state, void *user_data)
{
	ARG_UNUSED(user_data);
	int err = loa_store_save_state(state);

	LOG_INF("persist transaction=0x%08x status=%u result=%d", state->transaction_id,
		state->status, err);
	return err;
}

static int apply_state(const struct loa_message *state, void *user_data)
{
	ARG_UNUSED(user_data);
	LOG_INF("apply transaction=0x%08x status=%u", state->transaction_id, state->status);
	if (loa_status_output_test_active()) {
		(void)loa_status_output_test_pixel(UINT8_MAX, (struct loa_rgb){0});
	}
	loa_mood_indicator_set(state->status);
	return 0;
}

static void indication_destroy(struct bt_gatt_indicate_params *params)
{
	ARG_UNUSED(params);
	LOG_DBG("indication parameters released");
	atomic_clear(&indicating);
}

static void indication_complete(struct bt_conn *conn, struct bt_gatt_indicate_params *params,
				uint8_t err)
{
	ARG_UNUSED(conn);
	ARG_UNUSED(params);
	LOG_INF("indication complete att_err=0x%02x", err);
}

static void send_indication(struct k_work *work);

static int acknowledge_state(const struct loa_message *state, void *user_data)
{
	ARG_UNUSED(user_data);
	int err = loa_protocol_encode(state_payload, state);

	if (err == 0) {
		LOG_INF("queue indication transaction=0x%08x status=%u", state->transaction_id,
			state->status);
		k_work_submit(&indication_work);
	} else {
		LOG_ERR("indication encode failed err=%d", err);
	}
	return err;
}

static ssize_t read_state(struct bt_conn *conn, const struct bt_gatt_attr *attr, void *buf,
			  uint16_t len, uint16_t offset)
{
	uint8_t payload[LOA_PROTOCOL_PAYLOAD_LEN];

	ARG_UNUSED(attr);
	LOG_INF("state read transaction=0x%08x status=%u offset=%u len=%u",
		processor.current.transaction_id, processor.current.status, offset, len);
	if (loa_protocol_encode(payload, &processor.current) != 0) {
		return BT_GATT_ERR(BT_ATT_ERR_UNLIKELY);
	}

	return bt_gatt_attr_read(conn, attr, buf, len, offset, payload, sizeof(payload));
}

static ssize_t write_command(struct bt_conn *conn, const struct bt_gatt_attr *attr, const void *buf,
			     uint16_t len, uint16_t offset, uint8_t flags)
{
	int err;

	ARG_UNUSED(conn);
	ARG_UNUSED(attr);
	LOG_INF("command write len=%u offset=%u flags=0x%02x", len, offset, flags);
	if (offset != 0U) {
		return BT_GATT_ERR(BT_ATT_ERR_INVALID_OFFSET);
	}
	if ((flags & BT_GATT_WRITE_FLAG_PREPARE) != 0U || len != LOA_PROTOCOL_PAYLOAD_LEN) {
		return BT_GATT_ERR(BT_ATT_ERR_INVALID_ATTRIBUTE_LEN);
	}

	err = loa_receiver_process_payload(&processor, buf, len);
	LOG_INF("command process result=%d current_tx=0x%08x current_status=%u", err,
		processor.current.transaction_id, processor.current.status);
	if (err == -EINVAL) {
		return BT_GATT_ERR(BT_ATT_ERR_VALUE_NOT_ALLOWED);
	}
	if (err != 0) {
		return BT_GATT_ERR(BT_ATT_ERR_UNLIKELY);
	}

	return len;
}

static void state_ccc_changed(const struct bt_gatt_attr *attr, uint16_t value)
{
	ARG_UNUSED(attr);
	indications_enabled = value == BT_GATT_CCC_INDICATE;
	LOG_INF("CCC changed value=0x%04x indications=%u", value, indications_enabled);
}

/* Encrypted diagnostics: version, pixel index (255=end), R, G, B.
 * This characteristic leaves the six-byte status protocol and stored state alone. */
static struct bt_uuid_128 pixel_uuid =
	BT_UUID_INIT_128(BT_UUID_128_ENCODE(0x7f6c0003, 0x6b7e, 0x4c80, 0x9f2a, 0xf9b9d7e2a601));
static uint8_t pixel_payload[5] = {1, UINT8_MAX, 0, 0, 0};

static ssize_t read_pixel(struct bt_conn *conn, const struct bt_gatt_attr *attr, void *buf,
			  uint16_t len, uint16_t offset)
{
	const uint8_t idle[] = {1, UINT8_MAX, 0, 0, 0};
	const uint8_t *payload = loa_status_output_test_active() ? pixel_payload : idle;
	return bt_gatt_attr_read(conn, attr, buf, len, offset, payload, sizeof(pixel_payload));
}

static ssize_t write_pixel(struct bt_conn *conn, const struct bt_gatt_attr *attr, const void *buf,
			   uint16_t len, uint16_t offset, uint8_t flags)
{
	ARG_UNUSED(conn);
	ARG_UNUSED(attr);
	const uint8_t *data = buf;
	if (offset != 0 || (flags & BT_GATT_WRITE_FLAG_PREPARE) != 0 || len != 5) {
		return BT_GATT_ERR(BT_ATT_ERR_INVALID_ATTRIBUTE_LEN);
	}
	if (data[0] != 1 || (data[1] >= 4 && data[1] != UINT8_MAX)) {
		return BT_GATT_ERR(BT_ATT_ERR_VALUE_NOT_ALLOWED);
	}
	int err =
		loa_status_output_test_pixel(data[1], (struct loa_rgb){data[2], data[3], data[4]});
	if (err != 0) {
		return BT_GATT_ERR(BT_ATT_ERR_UNLIKELY);
	}
	memcpy(pixel_payload, data, sizeof(pixel_payload));
	LOG_INF("pixel test index=%u rgb=%u,%u,%u", data[1], data[2], data[3], data[4]);
	return len;
}

static struct bt_uuid_128 pairing_control_uuid =
	BT_UUID_INIT_128(BT_UUID_128_ENCODE(0x7f6c0004, 0x6b7e, 0x4c80, 0x9f2a, 0xf9b9d7e2a601));

static ssize_t write_pairing_control(struct bt_conn *conn, const struct bt_gatt_attr *attr,
				     const void *buf, uint16_t len, uint16_t offset, uint8_t flags)
{
	ARG_UNUSED(attr);
	if (offset != 0U || (flags & BT_GATT_WRITE_FLAG_PREPARE) != 0U ||
	    !loa_pairing_control_valid(buf, len)) {
		return BT_GATT_ERR(BT_ATT_ERR_VALUE_NOT_ALLOWED);
	}
	if (!bonded || conn != current_conn || bt_conn_get_security(conn) < BT_SECURITY_L2) {
		return BT_GATT_ERR(BT_ATT_ERR_AUTHORIZATION);
	}
	/* An ATT success response means the reset intent is durable. */
	int err = loa_pair_reset_request();
	LOG_INF("remote forget persisted=%d", err);
	return err == 0 ? len : BT_GATT_ERR(BT_ATT_ERR_UNLIKELY);
}

static struct bt_uuid_128 brightness_uuid =
	BT_UUID_INIT_128(BT_UUID_128_ENCODE(0x7f6c0005, 0x6b7e, 0x4c80, 0x9f2a, 0xf9b9d7e2a601));

static ssize_t read_brightness(struct bt_conn *conn, const struct bt_gatt_attr *attr, void *buf,
			       uint16_t len, uint16_t offset)
{
	uint8_t payload[LOA_BRIGHTNESS_PAYLOAD_LEN];
	struct loa_brightness value = loa_brightness_settings_get();
	(void)loa_brightness_encode(payload, &value);
	return bt_gatt_attr_read(conn, attr, buf, len, offset, payload, sizeof(payload));
}

static ssize_t write_brightness(struct bt_conn *conn, const struct bt_gatt_attr *attr,
				const void *buf, uint16_t len, uint16_t offset, uint8_t flags)
{
	ARG_UNUSED(attr);
	if (offset != 0U) {
		return BT_GATT_ERR(BT_ATT_ERR_INVALID_OFFSET);
	}
	if ((flags & BT_GATT_WRITE_FLAG_PREPARE) != 0U || len != LOA_BRIGHTNESS_PAYLOAD_LEN) {
		return BT_GATT_ERR(BT_ATT_ERR_INVALID_ATTRIBUTE_LEN);
	}
	if (!bonded || conn != current_conn || bt_conn_get_security(conn) < BT_SECURITY_L2) {
		return BT_GATT_ERR(BT_ATT_ERR_AUTHORIZATION);
	}
	int err = loa_brightness_settings_write(buf, len);
	if (err == -EINVAL) {
		return BT_GATT_ERR(BT_ATT_ERR_VALUE_NOT_ALLOWED);
	}
	return err == 0 ? len : BT_GATT_ERR(BT_ATT_ERR_UNLIKELY);
}

BT_GATT_SERVICE_DEFINE(
	loa_service, BT_GATT_PRIMARY_SERVICE(&service_uuid),
	BT_GATT_CHARACTERISTIC(&command_uuid.uuid, BT_GATT_CHRC_WRITE, BT_GATT_PERM_WRITE_ENCRYPT,
			       NULL, write_command, NULL),
	BT_GATT_CHARACTERISTIC(&state_uuid.uuid, BT_GATT_CHRC_READ | BT_GATT_CHRC_INDICATE,
			       BT_GATT_PERM_READ_ENCRYPT, read_state, NULL, NULL),
	BT_GATT_CCC(state_ccc_changed, BT_GATT_PERM_READ | BT_GATT_PERM_WRITE_ENCRYPT),
	BT_GATT_CHARACTERISTIC(&pixel_uuid.uuid, BT_GATT_CHRC_WRITE | BT_GATT_CHRC_READ,
			       BT_GATT_PERM_WRITE_ENCRYPT | BT_GATT_PERM_READ_ENCRYPT, read_pixel,
			       write_pixel, NULL),
	BT_GATT_CHARACTERISTIC(&pairing_control_uuid.uuid, BT_GATT_CHRC_WRITE,
			       BT_GATT_PERM_WRITE_ENCRYPT, NULL, write_pairing_control, NULL),
	BT_GATT_CHARACTERISTIC(&brightness_uuid.uuid, BT_GATT_CHRC_READ | BT_GATT_CHRC_WRITE,
			       BT_GATT_PERM_READ_ENCRYPT | BT_GATT_PERM_WRITE_ENCRYPT,
			       read_brightness, write_brightness, NULL));

static void send_indication(struct k_work *work)
{
	ARG_UNUSED(work);
	if (!indications_enabled || current_conn == NULL || !atomic_cas(&indicating, 0, 1)) {
		LOG_ERR("indication skipped enabled=%u connected=%u busy=%u", indications_enabled,
			current_conn != NULL, atomic_get(&indicating) != 0);
		return;
	}

	indication_params.attr = &loa_service.attrs[4];
	indication_params.func = indication_complete;
	indication_params.destroy = indication_destroy;
	indication_params.data = state_payload;
	indication_params.len = sizeof(state_payload);
	int err = bt_gatt_indicate(current_conn, &indication_params);

	if (err != 0) {
		LOG_ERR("indication queue failed err=%d", err);
		atomic_clear(&indicating);
	} else {
		LOG_INF("indication queued");
	}
}

static const struct bt_data advertising_data[] = {
	BT_DATA_BYTES(BT_DATA_FLAGS, BT_LE_AD_GENERAL | BT_LE_AD_NO_BREDR),
	BT_DATA_BYTES(BT_DATA_UUID128_ALL, LOA_BT_UUID_SERVICE_VAL),
};

static const struct bt_data scan_response_data[] = {
	BT_DATA(BT_DATA_NAME_COMPLETE, CONFIG_BT_DEVICE_NAME, sizeof(CONFIG_BT_DEVICE_NAME) - 1U),
};

static void bond_to_filter_list(const struct bt_bond_info *info, void *user_data)
{
	int *result = user_data;
	int err = bt_le_filter_accept_list_add(&info->addr);

	if (*result == 0 && err != 0) {
		*result = err;
	}
}

static int configure_filter_list(void)
{
	int err = bt_le_filter_accept_list_clear();

	if (err != 0) {
		LOG_ERR("filter list clear failed err=%d", err);
		return err;
	}
	bt_foreach_bond(BT_ID_DEFAULT, bond_to_filter_list, &err);
	LOG_INF("filter list configured result=%d", err);
	return err;
}

static int start_advertising(bool fast, bool filter_connections)
{
	struct bt_le_adv_param params = {
		.id = BT_ID_DEFAULT,
		.sid = 0U,
		.secondary_max_skip = 0U,
		.options = BT_LE_ADV_OPT_CONN,
		.interval_min = fast ? ADV_FAST_INTERVAL : ADV_SLOW_INTERVAL,
		.interval_max = fast ? ADV_FAST_INTERVAL : ADV_SLOW_INTERVAL,
		.peer = NULL,
	};
	int err;

	if (advertising) {
		(void)bt_le_adv_stop();
		advertising = false;
	}

	if (filter_connections) {
		err = configure_filter_list();
		if (err != 0) {
			return err;
		}
		params.options |= BT_LE_ADV_OPT_FILTER_CONN;
	}

	err = bt_le_adv_start(&params, advertising_data, ARRAY_SIZE(advertising_data),
			      scan_response_data, ARRAY_SIZE(scan_response_data));
	if (err == 0) {
		advertising = true;
	}
	LOG_INF("advertising start fast=%u filtered=%u result=%d", fast, filter_connections, err);
	return err;
}

static void restart_advertising(struct k_work *work)
{
	int err;

	ARG_UNUSED(work);

	if (current_conn != NULL) {
		LOG_INF("advertising restart skipped while connected");
		return;
	}

	if (bonded) {
		err = start_advertising(false, true);
	} else if (pairing_window_open) {
		err = start_advertising(true, false);
	} else {
		return;
	}

	/* The disconnected callback runs before Zephyr releases its final
	 * connection reference. With CONFIG_BT_MAX_CONN=1 an immediate
	 * connectable-advertising restart can therefore return -ENOMEM.
	 */
	if (err == -ENOMEM || err == -EAGAIN) {
		LOG_WRN("advertising resources busy err=%d; retrying", err);
		(void)k_work_reschedule(&advertising_restart_work, ADV_RETRY_DELAY);
	}
}

static void pairing_window_expired(struct k_work *work)
{
	ARG_UNUSED(work);
	pairing_window_open = false;
	LOG_INF("pairing window expired connected=%u bonded=%u", current_conn != NULL, bonded);
	if (current_conn != NULL) {
		return;
	}

	if (advertising) {
		(void)bt_le_adv_stop();
		advertising = false;
	}
	if (bonded) {
		loa_mood_indicator_set(processor.current.status);
		(void)start_advertising(false, true);
	} else {
		loa_device_indicator_set(LOA_DEVICE_UNPAIRED);
	}
}

static void connected(struct bt_conn *conn, uint8_t err)
{
	LOG_INF("connected err=%u", err);
	if (err != 0U) {
		return;
	}

	(void)k_work_cancel_delayable(&advertising_restart_work);
	advertising = false;
	current_conn = bt_conn_ref(conn);
	/* Bonded peers connect briefly for commands and once-per-minute reads.
	 * Transport activity must never replace the sign's actual status.
	 */
	if (!bonded) {
		loa_device_indicator_set(LOA_DEVICE_PAIRING);
	}
}

static void disconnected(struct bt_conn *conn, uint8_t reason)
{
	if (conn != current_conn) {
		return;
	}
	LOG_INF("disconnected reason=0x%02x bonded=%u pairing_window=%u", reason, bonded,
		pairing_window_open);

	bt_conn_unref(current_conn);
	current_conn = NULL;
	indications_enabled = false;
	atomic_clear(&indicating);

	if (bonded) {
		/* Preserve output and animation phase across routine disconnects. */
	} else if (pairing_window_open) {
		loa_device_indicator_set(LOA_DEVICE_PAIRING);
	} else {
		loa_device_indicator_set(LOA_DEVICE_UNPAIRED);
		return;
	}

	(void)k_work_reschedule(&advertising_restart_work, ADV_RESTART_DELAY);
}

BT_CONN_CB_DEFINE(connection_callbacks) = {
	.connected = connected,
	.disconnected = disconnected,
};

static void pairing_complete(struct bt_conn *conn, bool is_bonded)
{
	ARG_UNUSED(conn);
	LOG_INF("pairing complete bonded=%u", is_bonded);
	if (!is_bonded) {
		return;
	}

	bonded = true;
	pairing_window_open = false;
	(void)k_work_cancel_delayable(&pairing_timeout_work);
	loa_device_indicator_set(LOA_DEVICE_READY);
	loa_mood_indicator_set(processor.current.status);
}

static void pairing_failed(struct bt_conn *conn, enum bt_security_err reason)
{
	ARG_UNUSED(conn);
	LOG_ERR("pairing failed reason=%u", reason);
}

static struct bt_conn_auth_info_cb auth_info_callbacks = {
	.pairing_complete = pairing_complete,
	.pairing_failed = pairing_failed,
};

static void bond_found(const struct bt_bond_info *info, void *user_data)
{
	bool *found = user_data;

	ARG_UNUSED(info);
	*found = true;
}

bool loa_ble_server_has_bond(void)
{
	bool found = false;

	bt_foreach_bond(BT_ID_DEFAULT, bond_found, &found);
	LOG_INF("bond present=%u", found);
	return found;
}

int loa_ble_server_init(const struct loa_message *initial_state)
{
	k_work_init(&indication_work, send_indication);
	k_work_init_delayable(&advertising_restart_work, restart_advertising);
	k_work_init_delayable(&pairing_timeout_work, pairing_window_expired);
	loa_receiver_processor_init(&processor, initial_state, persist_state, apply_state,
				    acknowledge_state, NULL);
	int err = bt_conn_auth_info_cb_register(&auth_info_callbacks);

	LOG_INF("server initialized transaction=0x%08x status=%u err=%d",
		initial_state->transaction_id, initial_state->status, err);
	return err;
}

int loa_ble_server_start(bool pairing_requested)
{
	bonded = loa_ble_server_has_bond();
	LOG_INF("server start pairing_requested=%u bonded=%u", pairing_requested, bonded);
	if (bonded) {
		loa_device_indicator_set(LOA_DEVICE_READY);
		loa_mood_indicator_set(processor.current.status);
		return start_advertising(false, true);
	}

	if (!pairing_requested) {
		loa_device_indicator_set(LOA_DEVICE_UNPAIRED);
		return 0;
	}

	pairing_window_open = true;
	loa_device_indicator_set(LOA_DEVICE_PAIRING);
	loa_mood_indicator_set(LOA_STATUS_OFF);
	(void)k_work_reschedule(&pairing_timeout_work, PAIRING_WINDOW);
	return start_advertising(true, false);
}
```

## src/ble_server.h
```c
/* SPDX-License-Identifier: MIT */
#ifndef LOA_BLE_SERVER_H_
#define LOA_BLE_SERVER_H_

#include <stdbool.h>

#include <little_on_air/protocol.h>

int loa_ble_server_init(const struct loa_message *initial_state);
bool loa_ble_server_has_bond(void);
int loa_ble_server_start(bool pairing_requested);

#endif /* LOA_BLE_SERVER_H_ */
```

## src/brightness_settings.c
```c
/* SPDX-License-Identifier: MIT */
#include <errno.h>
#include <string.h>
#include <zephyr/kernel.h>
#include <zephyr/settings/settings.h>
#include "brightness_settings.h"
#include "status_output.h"

#define SETTINGS_KEY "loa_light/levels"
static struct loa_brightness saved = {0U, 50U, 50U};
static struct loa_brightness applied = {0U, 50U, 50U};
K_MUTEX_DEFINE(settings_lock);

static int load(const char *name, size_t len, settings_read_cb read_cb, void *cb_arg)
{
	uint8_t record[LOA_BRIGHTNESS_RECORD_LEN];
	if (strcmp(name, "levels") != 0) {
		return -ENOENT;
	}
	saved = loa_brightness_defaults();
	if (len == sizeof(record) && read_cb(cb_arg, record, sizeof(record)) == sizeof(record)) {
		(void)loa_brightness_record_decode(&saved, record, sizeof(record));
	}
	return 0;
}
SETTINGS_STATIC_HANDLER_DEFINE(loa_light, "loa_light", NULL, load, NULL, NULL);

static int persist(const struct loa_brightness *value, void *context)
{
	ARG_UNUSED(context);
	uint8_t record[LOA_BRIGHTNESS_RECORD_LEN];
	loa_brightness_record_encode(record, value);
	int err = settings_save_one(SETTINGS_KEY, record, sizeof(record));
	if (err == 0) {
		saved = *value;
	}
	return err;
}

static int apply(const struct loa_brightness *value, void *context)
{
	ARG_UNUSED(context);
	return loa_status_output_set_brightness(value->frame, value->indicator);
}

int loa_brightness_settings_init(void)
{
	int err = apply(&saved, NULL);
	if (err == 0) {
		applied = saved;
	}
	return err;
}

struct loa_brightness loa_brightness_settings_get(void)
{
	k_mutex_lock(&settings_lock, K_FOREVER);
	struct loa_brightness value = applied;
	k_mutex_unlock(&settings_lock);
	return value;
}

int loa_brightness_settings_write(const void *payload, size_t len)
{
	k_mutex_lock(&settings_lock, K_FOREVER);
	int err = loa_brightness_process(&applied, payload, len, persist, apply, NULL);
	k_mutex_unlock(&settings_lock);
	return err;
}
```

## src/brightness_settings.h
```c
/* SPDX-License-Identifier: MIT */
#pragma once
#include <little_on_air/brightness.h>

int loa_brightness_settings_init(void);
struct loa_brightness loa_brightness_settings_get(void);
int loa_brightness_settings_write(const void *payload, size_t len);
```

## src/device_indicator.c
```c
/* SPDX-License-Identifier: MIT */
#include <zephyr/kernel.h>
#include "status_output.h"
#include "device_indicator.h"

static enum loa_device_state mode;
static bool on;
K_MUTEX_DEFINE(device_lock);
static struct k_work_delayable device_work;

static void update(struct k_work *work)
{
	ARG_UNUSED(work);
	k_mutex_lock(&device_lock, K_FOREVER);
	(void)loa_status_output_set_device_rgb((struct loa_rgb){.red = on ? 255U : 0U});
	if (mode != LOA_DEVICE_READY) {
		uint32_t delay = mode == LOA_DEVICE_PAIRING ? 250U : on ? 1800U : 200U;
		on = !on;
		(void)k_work_reschedule(&device_work, K_MSEC(delay));
	}
	k_mutex_unlock(&device_lock);
}
void loa_device_indicator_init(void)
{
	k_work_init_delayable(&device_work, update);
	mode = LOA_DEVICE_READY;
	on = true;
}
void loa_device_indicator_set(enum loa_device_state state)
{
	k_mutex_lock(&device_lock, K_FOREVER);
	if (mode != state) {
		mode = state;
		on = true;
		(void)k_work_reschedule(&device_work, K_NO_WAIT);
	}
	k_mutex_unlock(&device_lock);
}
```

## src/device_indicator.h
```c
/* SPDX-License-Identifier: MIT */
#pragma once
enum loa_device_state {
	LOA_DEVICE_READY,
	LOA_DEVICE_PAIRING,
	LOA_DEVICE_UNPAIRED
};
void loa_device_indicator_init(void);
void loa_device_indicator_set(enum loa_device_state state);
```

## src/mood_indicator.c
```c
/* SPDX-License-Identifier: MIT */
#include <zephyr/kernel.h>

#include "mood_indicator.h"
#include "status_output.h"

static struct k_work_delayable mood_work;
static struct k_mutex mood_lock;
static enum loa_status mood;
static uint32_t started_at;

static void update_mood(struct k_work *work)
{
	ARG_UNUSED(work);
	k_mutex_lock(&mood_lock, K_FOREVER);
	(void)loa_status_output_set_status(mood, k_uptime_get_32() - started_at);
	uint16_t interval_ms = loa_status_animation_interval_ms(mood);
	if (interval_ms != 0U) {
		/* Anchor cadence to the mood change, not SPI transfer time. */
		uint16_t delay_ms = interval_ms - (k_uptime_get_32() - started_at) % interval_ms;
		(void)k_work_reschedule(&mood_work, K_MSEC(delay_ms));
	}
	k_mutex_unlock(&mood_lock);
}

int loa_mood_indicator_init(void)
{
	int err = loa_status_output_init();
	if (err != 0) {
		return err;
	}
	k_mutex_init(&mood_lock);
	k_work_init_delayable(&mood_work, update_mood);
	mood = LOA_STATUS_OFF;
	started_at = 0U;
	return 0;
}

void loa_mood_indicator_set(enum loa_status status)
{
	k_mutex_lock(&mood_lock, K_FOREVER);
	/* Same-state reconciliation must neither flash nor restart animation. */
	if (mood != status) {
		mood = status;
		started_at = k_uptime_get_32();
		(void)k_work_reschedule(&mood_work, K_NO_WAIT);
	}
	k_mutex_unlock(&mood_lock);
}
```

## src/mood_indicator.h
```c
/* SPDX-License-Identifier: MIT */
#ifndef LITTLE_ON_AIR_MOOD_INDICATOR_H_
#define LITTLE_ON_AIR_MOOD_INDICATOR_H_

#include <little_on_air/status.h>

int loa_mood_indicator_init(void);
void loa_mood_indicator_set(enum loa_status status);

#endif /* LITTLE_ON_AIR_MOOD_INDICATOR_H_ */
```

## src/padded_pixels.c
```c
/* SPDX-License-Identifier: MIT */
#include <errno.h>

#include <zephyr/device.h>
#include <zephyr/drivers/led_strip.h>
#include <zephyr/drivers/spi.h>
#include <zephyr/dt-bindings/led/led.h>
#include <zephyr/kernel.h>
#include <zephyr/sys/util.h>

#include <little_on_air/ws2812_frame.h>

#define PIXEL_NODE DT_ALIAS(loa_pixels)

/* Keep the sign driver tied to the existing wiring, timing and GRB mapping.
 * Fail a build rather than silently encode a different strip configuration.
 */
BUILD_ASSERT(DT_NODE_HAS_STATUS(PIXEL_NODE, okay), "The sign pixel configuration is required");
BUILD_ASSERT(DT_PROP(PIXEL_NODE, chain_length) == LOA_WS2812_MAX_PIXELS);
BUILD_ASSERT(DT_PROP(PIXEL_NODE, spi_max_frequency) == LOA_WS2812_SPI_HZ);
BUILD_ASSERT(LOA_WS2812_SPI_HZ <= DT_PROP(DT_BUS(PIXEL_NODE), max_frequency),
	     "SPI bus must support the requested clock without clamping");
BUILD_ASSERT(DT_NODE_HAS_COMPAT(PIXEL_NODE, loa_padded_ws2812_spi),
	     "Ten-bit symbols require the application-owned pixel binding");
BUILD_ASSERT(DT_PROP(PIXEL_NODE, reset_delay) == LOA_WS2812_RESET_US);
BUILD_ASSERT(DT_PROP(PIXEL_NODE, bits_per_symbol) == LOA_WS2812_SYMBOL_BITS);
BUILD_ASSERT(DT_PROP(PIXEL_NODE, spi_zero_frame) == LOA_WS2812_ZERO_SYMBOL);
BUILD_ASSERT(DT_PROP(PIXEL_NODE, spi_one_frame) == LOA_WS2812_ONE_SYMBOL);
BUILD_ASSERT(DT_PROP_LEN(PIXEL_NODE, color_mapping) == 3);
BUILD_ASSERT(DT_PROP_BY_IDX(PIXEL_NODE, color_mapping, 0) == LED_COLOR_ID_GREEN);
BUILD_ASSERT(DT_PROP_BY_IDX(PIXEL_NODE, color_mapping, 1) == LED_COLOR_ID_RED);
BUILD_ASSERT(DT_PROP_BY_IDX(PIXEL_NODE, color_mapping, 2) == LED_COLOR_ID_BLUE);
BUILD_ASSERT(LOA_WS2812_FRAME_BYTES <= BIT_MASK(DT_PROP(DT_BUS(PIXEL_NODE), easydma_maxcnt_bits)),
	     "The entire padded frame must fit in one DMA transfer");

static const struct spi_dt_spec bus =
	SPI_DT_SPEC_GET(PIXEL_NODE, SPI_OP_MODE_MASTER | SPI_TRANSFER_MSB | SPI_WORD_SET(8));
/* A single contiguous RAM buffer prevents a driver/software pause between
 * leading LOW and payload. This board's 16-bit DMA counter fits the full frame.
 */
static uint8_t frame[LOA_WS2812_FRAME_BYTES];
K_MUTEX_DEFINE(frame_lock);

static int update_pixels(const struct device *dev, struct led_rgb *pixels, size_t count)
{
	ARG_UNUSED(dev);
	if (pixels == NULL || count != LOA_WS2812_MAX_PIXELS) {
		return -EINVAL;
	}
	struct loa_rgb colors[LOA_WS2812_MAX_PIXELS];
	for (size_t i = 0; i < count; ++i) {
		colors[i] = (struct loa_rgb){pixels[i].r, pixels[i].g, pixels[i].b};
	}
	k_mutex_lock(&frame_lock, K_FOREVER);
	const int length = loa_ws2812_encode(colors, count, frame, sizeof(frame));
	int err = length;
	if (length > 0) {
		const struct spi_buf buffer = {.buf = frame, .len = (size_t)length};
		const struct spi_buf_set tx = {.buffers = &buffer, .count = 1};
		err = spi_write_dt(&bus, &tx);
	}
	/* Preserve the original post-transfer guard too. Unlike sleep alone, the
	 * padding clocks LOW onto MOSI before/after every pixel frame.
	 */
	k_usleep(LOA_WS2812_RESET_US);
	k_mutex_unlock(&frame_lock);
	return err;
}

static size_t pixel_count(const struct device *dev)
{
	ARG_UNUSED(dev);
	return LOA_WS2812_MAX_PIXELS;
}

static int init_pixels(const struct device *dev)
{
	ARG_UNUSED(dev);
	return spi_is_ready_dt(&bus) ? 0 : -ENODEV;
}

static DEVICE_API(led_strip, padded_pixels_api) = {
	.update_rgb = update_pixels,
	.length = pixel_count,
};

DEVICE_DT_DEFINE(PIXEL_NODE, init_pixels, NULL, NULL, NULL, POST_KERNEL,
		 CONFIG_LED_STRIP_INIT_PRIORITY, &padded_pixels_api);
```

## src/pair_reset.c
```c
/* SPDX-License-Identifier: MIT */
#include <errno.h>
#include <string.h>
#include <zephyr/kernel.h>
#include <zephyr/settings/settings.h>
#include <zephyr/sys/reboot.h>
#include "pair_reset.h"

static bool pending;
static int reset_settings(const char *name, size_t len, settings_read_cb read_cb, void *arg)
{
	uint8_t value;
	if (strcmp(name, "pending") != 0 || len != sizeof(value)) {
		return -ENOENT;
	}
	if (read_cb(arg, &value, sizeof(value)) != sizeof(value)) {
		return -EIO;
	}
	pending = value == 1U;
	return 0;
}
SETTINGS_STATIC_HANDLER_DEFINE(loa_pair, "loa_pair", NULL, reset_settings, NULL, NULL);

static void reboot_to_pair(struct k_work *work)
{
	ARG_UNUSED(work);
	sys_reboot(SYS_REBOOT_COLD);
}
K_WORK_DELAYABLE_DEFINE(reboot_work, reboot_to_pair);

bool loa_pair_reset_pending(void)
{
	return pending;
}
int loa_pair_reset_mark(void)
{
	const uint8_t value = 1U;
	int err = pending ? 0 : settings_save_one("loa_pair/pending", &value, sizeof(value));
	if (err == 0) {
		pending = true;
	}
	return err;
}
int loa_pair_reset_complete(void)
{
	int err = settings_delete("loa_pair/pending");
	if (err == 0 || err == -ENOENT) {
		pending = false;
		return 0;
	}
	return err;
}
int loa_pair_reset_request(void)
{
	int err = loa_pair_reset_mark();
	if (err == 0) {
		/* Give the encrypted write response time to reach the controller.
		 * The durable intent also completes if power is lost before reboot.
		 */
		(void)k_work_reschedule(&reboot_work, K_MSEC(1500));
	}
	return err;
}
```

## src/pair_reset.h
```c
/* SPDX-License-Identifier: MIT */
#pragma once
#include <stdbool.h>
bool loa_pair_reset_pending(void);
int loa_pair_reset_mark(void);
int loa_pair_reset_complete(void);
int loa_pair_reset_request(void);
```

## src/status_output.c
```c
/* SPDX-License-Identifier: MIT */
#include <errno.h>
#include <stdint.h>

#include <zephyr/device.h>
#include <zephyr/devicetree.h>
#include <zephyr/drivers/pwm.h>
#include <zephyr/drivers/led_strip.h>
#include <zephyr/kernel.h>

#include "status_output.h"

#ifndef LOA_LED_RED_CALIBRATION_PERMILLE
#define LOA_LED_RED_CALIBRATION_PERMILLE 1000U
#endif
#ifndef LOA_LED_GREEN_CALIBRATION_PERMILLE
#define LOA_LED_GREEN_CALIBRATION_PERMILLE 650U
#endif
#ifndef LOA_LED_BLUE_CALIBRATION_PERMILLE
#define LOA_LED_BLUE_CALIBRATION_PERMILLE 500U
#endif

static const struct pwm_dt_spec red_pwm = PWM_DT_SPEC_GET(DT_ALIAS(pwm_red));
static const struct pwm_dt_spec green_pwm = PWM_DT_SPEC_GET(DT_ALIAS(pwm_green));
static const struct pwm_dt_spec blue_pwm = PWM_DT_SPEC_GET(DT_ALIAS(pwm_blue));

static const struct device *const pixels = DEVICE_DT_GET(DT_ALIAS(loa_pixels));
static struct led_rgb pixel_colors[DT_PROP(DT_ALIAS(loa_pixels), chain_length)];
K_MUTEX_DEFINE(pixel_lock);
/* This lock covers both outputs so brightness changes preserve their raw colors. */
static uint16_t frame_brightness = 160U, device_brightness = 125U;
static struct loa_rgb device_color;
static uint8_t test_index;
static struct loa_rgb test_color;
static bool pixel_test_active;
static struct loa_rgb latest_colors[DT_PROP(DT_ALIAS(loa_pixels), chain_length)];
static struct k_work_delayable pixel_test_timeout;

static struct led_rgb scaled_pixel(struct loa_rgb color)
{
	return (struct led_rgb){
		.r = color.red * frame_brightness / 1000U,
		.g = color.green * frame_brightness / 1000U,
		.b = color.blue * frame_brightness / 1000U,
	};
}

static int restore_pixels(void)
{
	for (size_t i = 0; i < ARRAY_SIZE(pixel_colors); ++i) {
		struct loa_rgb raw = pixel_test_active
					     ? (i == test_index ? test_color : (struct loa_rgb){0})
					     : latest_colors[i];
		pixel_colors[i] = scaled_pixel(raw);
	}
	return led_strip_update_rgb(pixels, pixel_colors, ARRAY_SIZE(pixel_colors));
}

static void pixel_test_expired(struct k_work *work)
{
	ARG_UNUSED(work);
	(void)loa_status_output_test_pixel(UINT8_MAX, (struct loa_rgb){0});
}

static int set_channel(const struct pwm_dt_spec *channel, uint8_t intensity, uint16_t calibration)
{
	uint64_t pulse = channel->period;

	pulse *= intensity;
	pulse *= device_brightness;
	pulse *= calibration;
	pulse /= 255U * 1000U * 1000U;

	return pwm_set_pulse_dt(channel, (uint32_t)pulse);
}

int loa_status_output_init(void)
{
	if (!device_is_ready(pixels)) {
		return -ENODEV;
	}
	k_work_init_delayable(&pixel_test_timeout, pixel_test_expired);
	if (!pwm_is_ready_dt(&red_pwm) || !pwm_is_ready_dt(&green_pwm) ||
	    !pwm_is_ready_dt(&blue_pwm)) {
		return -ENODEV;
	}

	int err = loa_status_output_set_device_rgb((struct loa_rgb){.red = 255U});
	if (err != 0) {
		return err;
	}
	return loa_status_output_set_status(LOA_STATUS_OFF, 0U);
}

static int set_device_rgb(struct loa_rgb color)
{
	int err;

	err = set_channel(&red_pwm, color.red, LOA_LED_RED_CALIBRATION_PERMILLE);
	if (err != 0) {
		return err;
	}

	err = set_channel(&green_pwm, color.green, LOA_LED_GREEN_CALIBRATION_PERMILLE);
	if (err != 0) {
		return err;
	}

	err = set_channel(&blue_pwm, color.blue, LOA_LED_BLUE_CALIBRATION_PERMILLE);
	return err;
}

int loa_status_output_set_device_rgb(struct loa_rgb color)
{
	k_mutex_lock(&pixel_lock, K_FOREVER);
	device_color = color;
	int err = set_device_rgb(color);
	k_mutex_unlock(&pixel_lock);
	return err;
}

int loa_status_output_set_brightness(uint8_t frame, uint8_t indicator)
{
	if (frame > 100U || indicator > 100U) {
		return -EINVAL;
	}
	k_mutex_lock(&pixel_lock, K_FOREVER);
	uint16_t old_frame = frame_brightness, old_device = device_brightness;
	frame_brightness = loa_brightness_native(LOA_LIGHT_FRAME, frame);
	device_brightness = loa_brightness_native(LOA_LIGHT_SIGN_LED, indicator);
	int err = old_frame == frame_brightness ? 0 : restore_pixels();
	if (err == 0 && old_device != device_brightness) {
		err = set_device_rgb(device_color);
	}
	if (err != 0) {
		frame_brightness = old_frame;
		device_brightness = old_device;
		(void)restore_pixels();
		(void)set_device_rgb(device_color);
	}
	k_mutex_unlock(&pixel_lock);
	return err;
}

int loa_status_output_set_status(enum loa_status status, uint32_t elapsed_ms)
{
	if (!loa_status_is_valid(status)) {
		return -EINVAL;
	}
	k_mutex_lock(&pixel_lock, K_FOREVER);
	for (size_t i = 0; i < ARRAY_SIZE(latest_colors); ++i) {
		latest_colors[i] = loa_status_color_at(status, elapsed_ms, i);
	}
	int err = pixel_test_active ? 0 : restore_pixels();
	k_mutex_unlock(&pixel_lock);
	return err;
}

int loa_status_output_test_pixel(uint8_t index, struct loa_rgb color)
{
	int err;
	if (index != UINT8_MAX && index >= ARRAY_SIZE(pixel_colors)) {
		return -EINVAL;
	}
	k_mutex_lock(&pixel_lock, K_FOREVER);
	if (index == UINT8_MAX) {
		pixel_test_active = false;
		(void)k_work_cancel_delayable(&pixel_test_timeout);
		err = restore_pixels();
	} else {
		test_index = index;
		test_color = color;
		for (size_t i = 0; i < ARRAY_SIZE(pixel_colors); ++i) {
			pixel_colors[i] = i == index ? scaled_pixel(color) : (struct led_rgb){0};
		}
		err = led_strip_update_rgb(pixels, pixel_colors, ARRAY_SIZE(pixel_colors));
		if (err == 0) {
			pixel_test_active = true;
			(void)k_work_reschedule(&pixel_test_timeout, K_SECONDS(120));
		}
	}
	k_mutex_unlock(&pixel_lock);
	return err;
}

bool loa_status_output_test_active(void)
{
	k_mutex_lock(&pixel_lock, K_FOREVER);
	bool active = pixel_test_active;
	k_mutex_unlock(&pixel_lock);
	return active;
}
```
