## tests/unit/testcase.yaml
```yaml
tests:
  little_on_air.unit:
    type: unit
    tags:
      - little_on_air
      - unit
```

## west.yml
```yaml
manifest:
  version: "1.2"

  remotes:
    - name: zephyrproject-rtos
      url-base: https://github.com/zephyrproject-rtos

  projects:
    - name: zephyr
      remote: zephyrproject-rtos
      # Exact commit for the upstream v4.3.0 release tag.
      revision: 3568e1b6d5cdd51a6b964a2a1d6d29200fea2056
      import: true

  self:
    path: little-on-air
```
