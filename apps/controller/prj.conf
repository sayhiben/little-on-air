## CMakeLists.txt
```
# SPDX-License-Identifier: MIT
cmake_minimum_required(VERSION 3.20.0)

set(DTC_OVERLAY_FILE ${CMAKE_CURRENT_SOURCE_DIR}/../../boards/xiao_ble_nrf52840.overlay)

find_package(Zephyr REQUIRED HINTS $ENV{ZEPHYR_BASE})
project(little_on_air_controller)

include(${CMAKE_CURRENT_SOURCE_DIR}/../../cmake/loa-common.cmake)

target_sources(app PRIVATE
  src/ble_client.c
  src/main.c
)

target_include_directories(app PRIVATE src)
```

## sample.yaml
```
sample:
  name: Little On Air controller
tests:
  little_on_air.controller.build:
    build_only: true
    platform_allow:
      - xiao_ble/nrf52840
    tags:
      - bluetooth
      - little_on_air
```

## prj.conf
```kconfig
# Core and power
CONFIG_MAIN_STACK_SIZE=4096
CONFIG_SYSTEM_WORKQUEUE_STACK_SIZE=2048
CONFIG_PWM=y
CONFIG_SERIAL=n
CONFIG_CONSOLE=n
CONFIG_UART_CONSOLE=n
CONFIG_USB_DEVICE_STACK_NEXT=n
CONFIG_LOG=n
CONFIG_ASSERT=n
CONFIG_COMPILER_WARNINGS_AS_ERRORS=y

# Flash-backed application and Bluetooth settings
CONFIG_FLASH=y
CONFIG_FLASH_MAP=y
CONFIG_FLASH_PAGE_LAYOUT=y
CONFIG_NVS=y
CONFIG_SETTINGS=y
CONFIG_SETTINGS_NVS=y

# Bluetooth central with encrypted, bonded GATT
CONFIG_BT=y
CONFIG_BT_CENTRAL=y
CONFIG_BT_GATT_CLIENT=y
CONFIG_BT_SMP=y
CONFIG_BT_SMP_SC_PAIR_ONLY=y
CONFIG_BT_BONDABLE=y
CONFIG_BT_SETTINGS=y
CONFIG_BT_PRIVACY=y
CONFIG_BT_MAX_CONN=1
CONFIG_BT_MAX_PAIRED=1
CONFIG_BT_DEVICE_NAME="Little On Air Remote"
CONFIG_BT_ATT_TX_COUNT=3

# Random transaction identifiers
CONFIG_ENTROPY_GENERATOR=y
```

## debug.conf
```kconfig
# USB CDC diagnostics. Merge with prj.conf using EXTRA_CONF_FILE=debug.conf.
CONFIG_SERIAL=y
CONFIG_CONSOLE=y
CONFIG_UART_CONSOLE=y
CONFIG_STDOUT_CONSOLE=y
CONFIG_UART_LINE_CTRL=y
CONFIG_USB_DEVICE_STACK_NEXT=y
CONFIG_CDC_ACM_SERIAL_INITIALIZE_AT_BOOT=y
CONFIG_CDC_ACM_SERIAL_PID=0x0005
CONFIG_CDC_ACM_SERIAL_PRODUCT_STRING="Little On Air Controller Debug"

CONFIG_LOG=y
CONFIG_LOG_MODE_DEFERRED=y
CONFIG_LOG_BUFFER_SIZE=8192
CONFIG_LOG_DEFAULT_LEVEL=3
CONFIG_LOG_BACKEND_UART=y
CONFIG_LOG_PRINTK=y
CONFIG_ASSERT=y
```

## src/main.c
```c
/* SPDX-License-Identifier: MIT */
#include <errno.h>

#include <zephyr/bluetooth/bluetooth.h>
#include <zephyr/kernel.h>
#include <zephyr/logging/log.h>
#include <zephyr/random/random.h>
#include <zephyr/settings/settings.h>

#include <little_on_air/controller_fsm.h>
#include <little_on_air/indicator.h>
#include <little_on_air/reset_input.h>
#include <little_on_air/store.h>

#include "ble_client.h"

#define COMMAND_TIMEOUT        K_SECONDS(8)
#define ERROR_PATTERN_DURATION K_MSEC(1200)

LOG_MODULE_REGISTER(loa_controller_main);

static void sleep_forever(void)
{
	while (true) {
		k_sleep(K_FOREVER);
	}
}

static void show_confirmed(struct loa_controller_fsm *fsm, const struct loa_message *snapshot,
			   bool pairing_happened)
{
	LOG_INF("confirmed transaction=0x%08x status=%s pairing=%u", snapshot->transaction_id,
		loa_status_name(snapshot->status), pairing_happened);
	(void)loa_controller_on_snapshot(fsm, snapshot);
	(void)loa_store_save_state(snapshot);
	if (pairing_happened) {
		loa_indicator_play(LOA_PATTERN_PAIR_SUCCESS, snapshot->status, LOA_PATTERN_SOLID,
				   snapshot->status);
	} else {
		loa_indicator_set(LOA_PATTERN_SOLID, snapshot->status);
	}
}

static int reconcile_with_retries(struct loa_controller_fsm *fsm, bool pairing_mode)
{
	static const uint8_t retry_delays_seconds[] = {0U, 1U, 2U, 4U, 8U};
	struct loa_message snapshot;
	bool pairing_happened = false;

	loa_controller_begin_reconcile(fsm);
	for (size_t attempt = 0U; attempt < ARRAY_SIZE(retry_delays_seconds); ++attempt) {
		LOG_INF("reconcile attempt=%u pairing_mode=%u delay=%u", (unsigned int)attempt + 1U,
			pairing_mode, retry_delays_seconds[attempt]);
		if (retry_delays_seconds[attempt] != 0U) {
			loa_indicator_set(LOA_PATTERN_DESYNCED, fsm->confirmed_status);
			k_sleep(K_SECONDS(retry_delays_seconds[attempt]));
		}

		loa_indicator_set(LOA_PATTERN_SYNCING, fsm->confirmed_status);
		const k_timeout_t timeout =
			pairing_mode && attempt == 0U ? K_SECONDS(60) : COMMAND_TIMEOUT;
		int err = loa_ble_client_reconcile(&snapshot, timeout, &pairing_happened);

		if (err == 0) {
			show_confirmed(fsm, &snapshot, pairing_happened);
			return 0;
		}
		LOG_ERR("reconcile attempt=%u failed err=%d", (unsigned int)attempt + 1U, err);
	}

	(void)loa_controller_on_retries_exhausted(fsm);
	loa_indicator_set(LOA_PATTERN_DESYNCED, fsm->confirmed_status);
	LOG_ERR("reconcile retries exhausted");
	return -ETIMEDOUT;
}

int main(void)
{
	struct loa_controller_fsm fsm;
	struct loa_boot_input input;
	struct loa_message persisted = {
		.transaction_id = 0U,
		.status = LOA_STATUS_OFF,
	};
	enum loa_controller_action action;
	bool has_bond;
	int err;

	err = loa_indicator_init();
	if (err != 0) {
		return err;
	}
	loa_indicator_set(LOA_PATTERN_DESYNCED, LOA_STATUS_OFF);
	input = loa_reset_input_capture();
	LOG_INF("boot button_press=%u factory_reset=%u", input.button_press, input.factory_reset);

	err = loa_ble_client_init();
	if (err != 0) {
		LOG_ERR("BLE client init failed err=%d", err);
		return err;
	}
	err = bt_enable(NULL);
	if (err != 0) {
		LOG_ERR("Bluetooth enable failed err=%d", err);
		return err;
	}
	LOG_INF("Bluetooth enabled");
	err = settings_load();
	if (err != 0) {
		LOG_ERR("settings load failed err=%d", err);
		return err;
	}
	LOG_INF("settings loaded");
	err = loa_reset_input_resolve(&input);
	if (err != 0) {
		return err;
	}

	if (input.factory_reset) {
		(void)loa_ble_client_unpair_all();
		err = loa_store_clear_state();
		LOG_INF("factory reset state clear result=%d", err);
	}
	if (loa_store_has_state()) {
		persisted = loa_store_get_state();
	}

	has_bond = loa_ble_client_has_bond();
	loa_controller_fsm_init(&fsm, persisted.status);
	action = loa_controller_on_boot(&fsm, has_bond, input.button_press, input.factory_reset);
	LOG_INF("boot state bond=%u persisted_tx=0x%08x persisted_status=%s action=%u", has_bond,
		persisted.transaction_id, loa_status_name(persisted.status), action);

	switch (action) {
	case LOA_ACTION_PAIR:
		(void)reconcile_with_retries(&fsm, true);
		break;
	case LOA_ACTION_RECONCILE:
		(void)reconcile_with_retries(&fsm, false);
		break;
	case LOA_ACTION_SEND: {
		struct loa_message ack = {0};
		bool new_pairing = false;
		uint32_t transaction_id = sys_rand32_get();

		if (transaction_id == 0U) {
			transaction_id = 1U;
		}
		loa_controller_set_transaction(&fsm, transaction_id);
		LOG_INF("sending transaction=0x%08x status=%s", transaction_id,
			loa_status_name(fsm.pending.status));
		loa_indicator_set(LOA_PATTERN_SENDING, fsm.pending.status);

		err = loa_ble_client_send(&fsm.pending, &ack, COMMAND_TIMEOUT, &new_pairing);
		LOG_INF("send returned err=%d ack_tx=0x%08x ack_status=%u new_pairing=%u", err,
			ack.transaction_id, ack.status, new_pairing);
		(void)loa_controller_on_write_result(&fsm, err == 0);
		if (err == 0 && loa_controller_on_ack(&fsm, &ack) == LOA_ACTION_CONFIRM) {
			(void)loa_store_save_state(&ack);
			loa_indicator_set(LOA_PATTERN_SOLID, ack.status);
			LOG_INF("command confirmed status=%s", loa_status_name(ack.status));
			break;
		}

		(void)loa_controller_on_timeout(&fsm);
		LOG_ERR("command failed; showing error and reconciling");
		loa_indicator_play(LOA_PATTERN_ERROR, fsm.confirmed_status, LOA_PATTERN_SYNCING,
				   fsm.confirmed_status);
		k_sleep(ERROR_PATTERN_DURATION);
		(void)reconcile_with_retries(&fsm, false);
		break;
	}
	case LOA_ACTION_SHOW_DESYNCED:
	default:
		loa_indicator_set(LOA_PATTERN_DESYNCED, fsm.confirmed_status);
		LOG_INF("waiting desynced action=%u", action);
		break;
	}

	sleep_forever();
	return 0;
}
```

## src/ble_client.c
```c
/* SPDX-License-Identifier: MIT */
#include <errno.h>
#include <string.h>

#include <zephyr/bluetooth/bluetooth.h>
#include <zephyr/bluetooth/conn.h>
#include <zephyr/bluetooth/gatt.h>
#include <zephyr/bluetooth/hci.h>
#include <zephyr/bluetooth/uuid.h>
#include <zephyr/kernel.h>
#include <zephyr/logging/log.h>
#include <zephyr/sys/atomic.h>
#include <zephyr/sys/clock.h>

#include <little_on_air/protocol.h>

#include "ble_client.h"

#if !defined(CONFIG_BT_SMP_SC_PAIR_ONLY) || defined(CONFIG_BT_SMP_SC_ONLY)
#error "Little On Air requires LE Secure Connections pairing with Just Works support"
#endif

LOG_MODULE_REGISTER(loa_controller_ble);

static struct bt_uuid_128 service_uuid = BT_UUID_INIT_128(LOA_BT_UUID_SERVICE_VAL);
static struct bt_uuid_128 command_uuid = BT_UUID_INIT_128(LOA_BT_UUID_COMMAND_VAL);
static struct bt_uuid_128 state_uuid = BT_UUID_INIT_128(LOA_BT_UUID_STATE_VAL);
static struct bt_uuid_16 ccc_uuid = BT_UUID_INIT_16(BT_UUID_GATT_CCC_VAL);

static struct bt_conn *default_conn;
static struct bt_gatt_discover_params discover_params;
static struct bt_gatt_subscribe_params subscribe_params;
static struct bt_gatt_write_params write_params;
static struct bt_gatt_read_params read_params;

static struct k_sem connected_sem;
static struct k_sem disconnected_sem;
static struct k_sem security_sem;
static struct k_sem discovery_sem;
static struct k_sem write_sem;
static struct k_sem ack_sem;
static struct k_sem read_sem;

static atomic_t scan_active;
static atomic_t pairing_happened;
static int connection_result;
static int security_result;
static int discovery_result;
static int write_result;
static int read_result;
static uint16_t service_end_handle;
static uint16_t command_value_handle;
static uint16_t state_value_handle;
static struct loa_message indicated_state;
static struct loa_message read_state;

enum discovery_stage {
	DISCOVER_SERVICE,
	DISCOVER_COMMAND,
	DISCOVER_STATE,
	DISCOVER_CCC,
};

static enum discovery_stage discovery_stage;

static void reset_operation_state(void)
{
	k_sem_reset(&connected_sem);
	k_sem_reset(&disconnected_sem);
	k_sem_reset(&security_sem);
	k_sem_reset(&discovery_sem);
	k_sem_reset(&write_sem);
	k_sem_reset(&ack_sem);
	k_sem_reset(&read_sem);
	connection_result = -ETIMEDOUT;
	security_result = -ETIMEDOUT;
	discovery_result = -ETIMEDOUT;
	write_result = -ETIMEDOUT;
	read_result = -ETIMEDOUT;
	command_value_handle = 0U;
	state_value_handle = 0U;
	atomic_clear(&pairing_happened);
}

static bool advertisement_has_service(struct bt_data *data, void *user_data)
{
	static const uint8_t expected_uuid[] = {LOA_BT_UUID_SERVICE_VAL};
	bool *found = user_data;

	if (data->type != BT_DATA_UUID128_ALL && data->type != BT_DATA_UUID128_SOME) {
		return true;
	}

	for (size_t offset = 0U; offset + sizeof(expected_uuid) <= data->data_len;
	     offset += sizeof(expected_uuid)) {
		if (memcmp(&data->data[offset], expected_uuid, sizeof(expected_uuid)) == 0) {
			*found = true;
			return false;
		}
	}

	return true;
}

static void device_found(const bt_addr_le_t *address, int8_t rssi, uint8_t type,
			 struct net_buf_simple *advertising_data)
{
	char address_string[BT_ADDR_LE_STR_LEN];
	bool found = false;
	int err;

	if (type != BT_GAP_ADV_TYPE_ADV_IND && type != BT_GAP_ADV_TYPE_ADV_DIRECT_IND &&
	    type != BT_GAP_ADV_TYPE_EXT_ADV) {
		return;
	}

	bt_data_parse(advertising_data, advertisement_has_service, &found);
	if (!found || !atomic_cas(&scan_active, 1, 0)) {
		return;
	}

	bt_addr_le_to_str(address, address_string, sizeof(address_string));
	LOG_INF("scan match peer=%s rssi=%d type=%u", address_string, rssi, type);

	err = bt_le_scan_stop();
	if (err != 0 && err != -EALREADY) {
		LOG_ERR("scan stop failed err=%d", err);
		connection_result = err;
		k_sem_give(&connected_sem);
		return;
	}

	err = bt_conn_le_create(address, BT_CONN_LE_CREATE_CONN, BT_LE_CONN_PARAM_DEFAULT,
				&default_conn);
	if (err != 0) {
		LOG_ERR("connection create failed err=%d", err);
		connection_result = err;
		k_sem_give(&connected_sem);
	} else {
		LOG_INF("connection create queued");
	}
}

static void connected(struct bt_conn *conn, uint8_t err)
{
	if (conn != default_conn) {
		return;
	}

	LOG_INF("connected err=%u", err);
	connection_result = err == 0U ? 0 : -ECONNREFUSED;
	k_sem_give(&connected_sem);
}

static void disconnected(struct bt_conn *conn, uint8_t reason)
{
	if (conn == default_conn) {
		LOG_INF("disconnected reason=0x%02x", reason);
		k_sem_give(&disconnected_sem);
	}
}

static void security_changed(struct bt_conn *conn, bt_security_t level, enum bt_security_err err)
{
	if (conn != default_conn) {
		return;
	}

	LOG_INF("security changed level=%u err=%u", level, err);
	security_result = err == BT_SECURITY_ERR_SUCCESS && level >= BT_SECURITY_L2 ? 0 : -EACCES;
	k_sem_give(&security_sem);
}

BT_CONN_CB_DEFINE(connection_callbacks) = {
	.connected = connected,
	.disconnected = disconnected,
	.security_changed = security_changed,
};

static void pairing_complete(struct bt_conn *conn, bool bonded)
{
	LOG_INF("pairing complete ours=%u bonded=%u", conn == default_conn, bonded);
	if (conn == default_conn && bonded) {
		atomic_set(&pairing_happened, 1);
	}
}

static void pairing_failed(struct bt_conn *conn, enum bt_security_err reason)
{
	LOG_ERR("pairing failed ours=%u reason=%u", conn == default_conn, reason);
	if (conn == default_conn) {
		security_result = -EACCES;
		k_sem_give(&security_sem);
	}
}

static struct bt_conn_auth_info_cb auth_info_callbacks = {
	.pairing_complete = pairing_complete,
	.pairing_failed = pairing_failed,
};

static uint8_t indication_received(struct bt_conn *conn, struct bt_gatt_subscribe_params *params,
				   const void *data, uint16_t length)
{
	ARG_UNUSED(conn);
	if (data == NULL) {
		LOG_INF("subscription removed");
		params->value_handle = 0U;
		return BT_GATT_ITER_STOP;
	}

	int err = loa_protocol_decode(&indicated_state, data, length);

	if (err == 0) {
		LOG_INF("indication transaction=0x%08x status=%u", indicated_state.transaction_id,
			indicated_state.status);
		k_sem_give(&ack_sem);
	} else {
		LOG_ERR("invalid indication len=%u err=%d", length, err);
	}

	return BT_GATT_ITER_CONTINUE;
}

static void subscription_complete(struct bt_conn *conn, uint8_t err,
				  struct bt_gatt_subscribe_params *params)
{
	ARG_UNUSED(conn);
	ARG_UNUSED(params);
	LOG_INF("subscription complete att_err=0x%02x", err);
	discovery_result = err == 0U ? 0 : -EIO;
	k_sem_give(&discovery_sem);
}

static uint8_t discovery_callback(struct bt_conn *conn, const struct bt_gatt_attr *attr,
				  struct bt_gatt_discover_params *params)
{
	int err;

	ARG_UNUSED(params);
	if (attr == NULL) {
		LOG_ERR("discovery stage=%u returned no attribute", discovery_stage);
		discovery_result = -ENOENT;
		k_sem_give(&discovery_sem);
		return BT_GATT_ITER_STOP;
	}

	switch (discovery_stage) {
	case DISCOVER_SERVICE: {
		const struct bt_gatt_service_val *service = attr->user_data;

		service_end_handle = service->end_handle;
		LOG_INF("service handles start=0x%04x end=0x%04x", attr->handle,
			service_end_handle);
		discovery_stage = DISCOVER_COMMAND;
		discover_params.uuid = &command_uuid.uuid;
		discover_params.start_handle = attr->handle + 1U;
		discover_params.end_handle = service_end_handle;
		discover_params.type = BT_GATT_DISCOVER_CHARACTERISTIC;
		break;
	}
	case DISCOVER_COMMAND:
		command_value_handle = bt_gatt_attr_value_handle(attr);
		LOG_INF("command value handle=0x%04x", command_value_handle);
		discovery_stage = DISCOVER_STATE;
		discover_params.uuid = &state_uuid.uuid;
		discover_params.start_handle = command_value_handle + 1U;
		discover_params.end_handle = service_end_handle;
		discover_params.type = BT_GATT_DISCOVER_CHARACTERISTIC;
		break;
	case DISCOVER_STATE:
		state_value_handle = bt_gatt_attr_value_handle(attr);
		LOG_INF("state value handle=0x%04x", state_value_handle);
		discovery_stage = DISCOVER_CCC;
		discover_params.uuid = &ccc_uuid.uuid;
		discover_params.start_handle = state_value_handle + 1U;
		discover_params.end_handle = service_end_handle;
		discover_params.type = BT_GATT_DISCOVER_DESCRIPTOR;
		break;
	case DISCOVER_CCC:
		LOG_INF("CCC handle=0x%04x; subscribing", attr->handle);
		memset(&subscribe_params, 0, sizeof(subscribe_params));
		subscribe_params.notify = indication_received;
		subscribe_params.subscribe = subscription_complete;
		subscribe_params.value_handle = state_value_handle;
		subscribe_params.ccc_handle = attr->handle;
		subscribe_params.value = BT_GATT_CCC_INDICATE;
		subscribe_params.min_security = BT_SECURITY_L2;
		atomic_set_bit(subscribe_params.flags, BT_GATT_SUBSCRIBE_FLAG_VOLATILE);
		err = bt_gatt_subscribe(conn, &subscribe_params);
		if (err != 0 && err != -EALREADY) {
			LOG_ERR("subscribe queue failed err=%d", err);
			discovery_result = err;
			k_sem_give(&discovery_sem);
		} else if (err == -EALREADY) {
			discovery_result = 0;
			k_sem_give(&discovery_sem);
		}
		return BT_GATT_ITER_STOP;
	default:
		return BT_GATT_ITER_STOP;
	}

	err = bt_gatt_discover(conn, &discover_params);
	if (err != 0) {
		LOG_ERR("next discovery stage=%u failed err=%d", discovery_stage, err);
		discovery_result = err;
		k_sem_give(&discovery_sem);
	}
	return BT_GATT_ITER_STOP;
}

static int discover_service(k_timepoint_t deadline)
{
	memset(&discover_params, 0, sizeof(discover_params));
	discovery_stage = DISCOVER_SERVICE;
	discover_params.uuid = &service_uuid.uuid;
	discover_params.func = discovery_callback;
	discover_params.start_handle = BT_ATT_FIRST_ATTRIBUTE_HANDLE;
	discover_params.end_handle = BT_ATT_LAST_ATTRIBUTE_HANDLE;
	discover_params.type = BT_GATT_DISCOVER_PRIMARY;

	discovery_result = bt_gatt_discover(default_conn, &discover_params);
	if (discovery_result != 0) {
		LOG_ERR("service discovery queue failed err=%d", discovery_result);
		return discovery_result;
	}

	if (k_sem_take(&discovery_sem, sys_timepoint_timeout(deadline)) != 0) {
		LOG_ERR("service preparation timed out");
		return -ETIMEDOUT;
	}
	LOG_INF("service preparation result=%d", discovery_result);
	return discovery_result;
}

static int connect_and_prepare(k_timepoint_t deadline)
{
	static const struct bt_le_scan_param scan_params = {
		.type = BT_LE_SCAN_TYPE_PASSIVE,
		.options = BT_LE_SCAN_OPT_FILTER_DUPLICATE,
		.interval = BT_GAP_SCAN_FAST_INTERVAL,
		.window = BT_GAP_SCAN_FAST_WINDOW,
	};
	int err;

	reset_operation_state();
	atomic_set(&scan_active, 1);
	LOG_INF("starting passive scan");
	err = bt_le_scan_start(&scan_params, device_found);
	if (err != 0) {
		LOG_ERR("scan start failed err=%d", err);
		atomic_clear(&scan_active);
		return err;
	}

	if (k_sem_take(&connected_sem, sys_timepoint_timeout(deadline)) != 0) {
		if (atomic_cas(&scan_active, 1, 0)) {
			(void)bt_le_scan_stop();
		}
		LOG_ERR("scan/connect timed out");
		return -ETIMEDOUT;
	}
	if (connection_result != 0) {
		LOG_ERR("connection failed result=%d", connection_result);
		return connection_result;
	}

	if (bt_conn_get_security(default_conn) >= BT_SECURITY_L2) {
		LOG_INF("connection already encrypted level=%u",
			bt_conn_get_security(default_conn));
		security_result = 0;
	} else {
		LOG_INF("requesting security level 2");
		err = bt_conn_set_security(default_conn, BT_SECURITY_L2);
		if (err != 0 && err != -EALREADY) {
			LOG_ERR("security request failed err=%d", err);
			return err;
		}
		if (k_sem_take(&security_sem, sys_timepoint_timeout(deadline)) != 0) {
			LOG_ERR("security timed out");
			return -ETIMEDOUT;
		}
		if (security_result != 0) {
			LOG_ERR("security failed result=%d", security_result);
			return security_result;
		}
	}

	return discover_service(deadline);
}

static void disconnect_and_release(void)
{
	struct bt_conn_info info;

	if (atomic_cas(&scan_active, 1, 0)) {
		(void)bt_le_scan_stop();
	}

	if (default_conn == NULL) {
		return;
	}

	if (bt_conn_get_info(default_conn, &info) == 0 &&
	    info.state != BT_CONN_STATE_DISCONNECTED) {
		LOG_INF("disconnecting state=%u", info.state);
		(void)bt_conn_disconnect(default_conn, BT_HCI_ERR_REMOTE_USER_TERM_CONN);
		if (info.state == BT_CONN_STATE_CONNECTED) {
			(void)k_sem_take(&disconnected_sem, K_MSEC(250));
		}
	}

	bt_conn_unref(default_conn);
	default_conn = NULL;
	LOG_INF("connection released");
}

static void write_complete(struct bt_conn *conn, uint8_t err, struct bt_gatt_write_params *params)
{
	ARG_UNUSED(conn);
	ARG_UNUSED(params);
	LOG_INF("write complete att_err=0x%02x", err);
	write_result = err == 0U ? 0 : -EIO;
	k_sem_give(&write_sem);
}

static uint8_t read_complete(struct bt_conn *conn, uint8_t err, struct bt_gatt_read_params *params,
			     const void *data, uint16_t length)
{
	ARG_UNUSED(conn);
	ARG_UNUSED(params);
	if (err != 0U) {
		LOG_ERR("state read failed att_err=0x%02x", err);
		read_result = -EIO;
		k_sem_give(&read_sem);
		return BT_GATT_ITER_STOP;
	}

	if (data != NULL) {
		read_result = loa_protocol_decode(&read_state, data, length);
		if (read_result == 0) {
			LOG_INF("state read transaction=0x%08x status=%u",
				read_state.transaction_id, read_state.status);
		} else {
			LOG_ERR("invalid state read len=%u err=%d", length, read_result);
		}
		k_sem_give(&read_sem);
	}
	return BT_GATT_ITER_STOP;
}

static int read_snapshot(struct loa_message *snapshot, k_timepoint_t deadline)
{
	memset(&read_params, 0, sizeof(read_params));
	read_params.func = read_complete;
	read_params.handle_count = 1U;
	read_params.single.handle = state_value_handle;
	read_params.single.offset = 0U;
	read_result = -ETIMEDOUT;
	k_sem_reset(&read_sem);

	int err = bt_gatt_read(default_conn, &read_params);

	if (err != 0) {
		LOG_ERR("state read queue failed err=%d", err);
		return err;
	}
	if (k_sem_take(&read_sem, sys_timepoint_timeout(deadline)) != 0) {
		LOG_ERR("state read timed out");
		return -ETIMEDOUT;
	}
	if (read_result == 0) {
		*snapshot = read_state;
	}
	return read_result;
}

int loa_ble_client_init(void)
{
	k_sem_init(&connected_sem, 0, 1);
	k_sem_init(&disconnected_sem, 0, 1);
	k_sem_init(&security_sem, 0, 1);
	k_sem_init(&discovery_sem, 0, 1);
	k_sem_init(&write_sem, 0, 1);
	k_sem_init(&ack_sem, 0, 1);
	k_sem_init(&read_sem, 0, 1);
	int err = bt_conn_auth_info_cb_register(&auth_info_callbacks);

	LOG_INF("client initialized err=%d", err);
	return err;
}

static void bond_found(const struct bt_bond_info *info, void *user_data)
{
	bool *found = user_data;

	ARG_UNUSED(info);
	*found = true;
}

bool loa_ble_client_has_bond(void)
{
	bool found = false;

	bt_foreach_bond(BT_ID_DEFAULT, bond_found, &found);
	LOG_INF("bond present=%u", found);
	return found;
}

int loa_ble_client_unpair_all(void)
{
	int err = bt_unpair(BT_ID_DEFAULT, BT_ADDR_LE_ANY);

	LOG_INF("unpair all result=%d", err);
	return err;
}

int loa_ble_client_reconcile(struct loa_message *snapshot, k_timeout_t timeout, bool *new_pairing)
{
	k_timepoint_t deadline = sys_timepoint_calc(timeout);
	int err = connect_and_prepare(deadline);

	if (err == 0) {
		err = read_snapshot(snapshot, deadline);
	}
	LOG_INF("reconcile result=%d new_pairing=%u", err, atomic_get(&pairing_happened) != 0);
	if (new_pairing != NULL) {
		*new_pairing = atomic_get(&pairing_happened) != 0;
	}
	disconnect_and_release();
	return err;
}

int loa_ble_client_send(const struct loa_message *command, struct loa_message *ack,
			k_timeout_t timeout, bool *new_pairing)
{
	uint8_t payload[LOA_PROTOCOL_PAYLOAD_LEN];
	k_timepoint_t deadline = sys_timepoint_calc(timeout);
	int err = connect_and_prepare(deadline);

	LOG_INF("send transaction=0x%08x status=%u prepare_result=%d", command->transaction_id,
		command->status, err);

	if (err != 0) {
		goto done;
	}

	err = loa_protocol_encode(payload, command);
	if (err != 0) {
		goto done;
	}

	k_sem_reset(&write_sem);
	k_sem_reset(&ack_sem);
	memset(&write_params, 0, sizeof(write_params));
	write_params.func = write_complete;
	write_params.handle = command_value_handle;
	write_params.offset = 0U;
	write_params.data = payload;
	write_params.length = sizeof(payload);
	write_result = -ETIMEDOUT;

	err = bt_gatt_write(default_conn, &write_params);
	if (err != 0) {
		LOG_ERR("write queue failed err=%d", err);
		goto done;
	}
	if (k_sem_take(&write_sem, sys_timepoint_timeout(deadline)) != 0 || write_result != 0) {
		err = write_result;
		LOG_ERR("write response failed result=%d", err);
		goto done;
	}

	if (k_sem_take(&ack_sem, sys_timepoint_timeout(deadline)) == 0 &&
	    indicated_state.transaction_id == command->transaction_id &&
	    indicated_state.status == command->status) {
		*ack = indicated_state;
		err = 0;
		goto done;
	}

	/* A readback recovers the case where the indication was applied but lost. */
	LOG_WRN("matching indication not received; reading state back");
	err = read_snapshot(ack, deadline);
	if (err == 0 &&
	    (ack->transaction_id != command->transaction_id || ack->status != command->status)) {
		err = -EAGAIN;
	}

done:
	LOG_INF("send final result=%d", err);
	if (new_pairing != NULL) {
		*new_pairing = atomic_get(&pairing_happened) != 0;
	}
	disconnect_and_release();
	return err;
}
```

## src/ble_client.h
```c
/* SPDX-License-Identifier: MIT */
#ifndef LOA_BLE_CLIENT_H_
#define LOA_BLE_CLIENT_H_

#include <stdbool.h>

#include <zephyr/kernel.h>

#include <little_on_air/protocol.h>

int loa_ble_client_init(void);
bool loa_ble_client_has_bond(void);
int loa_ble_client_unpair_all(void);
int loa_ble_client_reconcile(struct loa_message *snapshot, k_timeout_t timeout, bool *new_pairing);
int loa_ble_client_send(const struct loa_message *command, struct loa_message *ack,
			k_timeout_t timeout, bool *new_pairing);

#endif /* LOA_BLE_CLIENT_H_ */
```
