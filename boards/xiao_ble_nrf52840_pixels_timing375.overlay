/* Add AFTER xiao_ble_nrf52840_pixels.overlay. Only the timing changes.
 * The repository-owned driver supports 10-bit symbols; the upstream WS2812
 * SPI driver supports at most 8, so this has a separate binding.
 */
&loa_pixels {
	compatible = "loa,padded-ws2812-spi";
	spi-max-frequency = <8000000>;
	bits-per-symbol = <10>;
	spi-zero-frame = <0x380>;
	spi-one-frame = <0x3f0>;
};
